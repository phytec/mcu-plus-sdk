/**
 * These arguments were used when this file was generated. They will be automatically applied on subsequent loads
 * via the GUI or CLI. Run CLI with '--help' for additional information on how to override these arguments.
 * @cliArgs --device "AM64x" --package "ALV" --part "ALV" --context "icss_g0_tx_pru1" --product "MCU_PLUS_SDK_AM64x@12.01.00"
 * @versions {"tool":"1.20.0+3587"}
 */